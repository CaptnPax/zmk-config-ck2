## config/boards/shields/Kconfig.defconfig
```kconfig
if SHIELD_CK2_LEFT

config ZMK_KEYBOARD_NAME
    default "ck2"

config ZMK_SPLIT_ROLE_CENTRAL
    default y

endif

if SHIELD_CK2_LEFT || SHIELD_CK2_RIGHT

config ZMK_SPLIT
    default y

endif
```

## config/boards/shields/Kconfig.shield
```kconfig
config SHIELD_CK2_LEFT
    def_bool $(shields_list_contains,ck2_left)

config SHIELD_CK2_RIGHT
    def_bool $(shields_list_contains,ck2_right)
```
